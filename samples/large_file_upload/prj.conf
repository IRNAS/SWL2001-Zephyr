## CMakeLists.txt
```
# SPDX-License-Identifier: Apache-2.0

cmake_minimum_required(VERSION 3.13.1)

# create compile_commands.json for clang
set(CMAKE_EXPORT_COMPILE_COMMANDS on)

find_package(Zephyr HINTS $ENV{ZEPHYR_BASE})
project(sample_lorawan)

zephyr_compile_options(-fdiagnostics-color=always)

target_sources(app PRIVATE src/main.c)

target_include_directories(app PRIVATE src)
```

## sample.yaml
```
sample:
  description: Demonstrates uploading a large file over LoRaWAN
  name: LoRaWAN large file upload
common:
  tags:
    - release
  platform_allow:
    - nrf52840dk_nrf52840
tests:
  sample.large_file_upload: {}
```

## prj.conf
```kconfig
# required for floorf (which is used within the smtc_modem lib)
CONFIG_NEWLIB_LIBC=y

# stack size (2048 required by Semtech)
CONFIG_MAIN_STACK_SIZE=4096
# some operations will be triggered from the system workq, so match above stack size
CONFIG_SYSTEM_WORKQUEUE_STACK_SIZE=4096
# heap size
CONFIG_HEAP_MEM_POOL_SIZE=4096

CONFIG_LOG_BUFFER_SIZE=4096

CONFIG_PINCTRL=y

CONFIG_GPIO=y
CONFIG_SERIAL=y
CONFIG_CONSOLE=y
CONFIG_UART_CONSOLE=y
CONFIG_LOG=y
CONFIG_LOG_BACKEND_UART=y

CONFIG_TEST_RANDOM_GENERATOR=y

CONFIG_SPI=y
CONFIG_LR11XX_LIB=y
# CONFIG_LR11XX_LOG_LEVEL_INF=y

CONFIG_LORA_BASICS_MODEM=y
CONFIG_LORA_BASICS_MODEM_FILE_UPLOAD=y

#requirements for CONFIG_LORA_BASICS_MODEM
CONFIG_REBOOT=y

CONFIG_SETTINGS=y
CONFIG_SETTINGS_NVS=y

CONFIG_NVS=y
CONFIG_FLASH=y
CONFIG_FLASH_MAP=y

# debug
CONFIG_ASSERT=y
CONFIG_DEBUG=y
```

## src/main.c
```c
/** @file main.c
 *
 * @brief Large file upload example
 *
 * @par
 * COPYRIGHT NOTICE: (c) 2022 Irnas. All rights reserved.
 */

#include <smtc_modem_api.h>

#include <smtc_app.h>
#include <smtc_modem_api_str.h>

/* include hal and ralf so that initialization can be done */
#include <ralf_lr11xx.h>
#include <smtc_modem_hal.h>

#include <zephyr/device.h>
#include <zephyr/kernel.h>
#include <zephyr/logging/log.h>

#include <file.h>

LOG_MODULE_REGISTER(main);

/* ---------------- Function declarations ---------------- */

static void on_modem_reset(uint16_t reset_count);
static void on_modem_network_joined(void);
static void on_modem_upload_done(smtc_modem_event_uploaddone_status_t status);

/* ---------------- SAMPLE CONFIGURATION ---------------- */

/**
 * @brief Large file upload encryption mode
 */
#define APP_SMTC_MODEM_LFU_CIPHER_MODE SMTC_MODEM_FILE_UPLOAD_NO_CIPHER

/**
 * @brief Size in byte of the file to be uploaded (from 1 to 2048 included)
 *
 * 2048 is the limit here since that is the size of the text array.
 * smtc_modem_file_upload_init can be called with a maximum size of 8180 bytes.
 */
#define APP_SMTC_MODEM_LFU_SIZE 256

/**
 * @brief Average delay in second between two uplinks
 */
#define APP_SMTC_MODEM_LFU_AVERAGE_DELAY 10

/* ---------------- LoRaWAN Configurations ---------------- */

/* Stack id value (multistack modem is not yet available, so use 0) */
#define STACK_ID 0

/*LoRaWAN configuration */
static struct smtc_app_lorawan_cfg lorawan_cfg = {
	.use_chip_eui_as_dev_eui = true,
	.join_eui = {0x00, 0x00, 0x00, 0x00, 0x00, 0x00, 0x00, 0x00},
	.app_key = {0x15, 0x1B, 0x76, 0x0D, 0xED, 0x74, 0x87, 0xE7, 0x8A, 0xCA, 0xE8, 0xC8, 0x74,
		    0x16, 0x31, 0x19},
	.class = SMTC_MODEM_CLASS_A,
	.region = SMTC_MODEM_REGION_EU_868,
};

static struct smtc_app_event_callbacks event_callbacks = {
	.reset = on_modem_reset,
	.joined = on_modem_network_joined,
	.upload_done = on_modem_upload_done,

};

/* lr11xx radio context and its use in the ralf layer */
const ralf_t modem_radio = RALF_LR11XX_INSTANTIATE(DEVICE_DT_GET(DT_NODELABEL(lr11xx)));

/* ---------------- Main ---------------- */

K_SEM_DEFINE(main_sleep_sem, 0, 1);

void main(void)
{
	/* configure LoRaWAN modem */

	/* Init the modem and use provided event callbacks.
	 * Please note that the reset callback will be called immediately after the first call to
	 * smtc_modem_run_engine because of reset detection.
	 */
	smtc_app_init(&modem_radio, &event_callbacks, NULL);
	smtc_app_display_versions();

	/* Enter main loop:
	 * The fist call to smtc_modem_run_engine will trigger the reset callback.
	 */

	while (1) {
		/* Execute modem runtime, this function must be called again in sleep_time_ms
		 * milliseconds or sooner. */
		uint32_t sleep_time_ms = smtc_modem_run_engine();

		LOG_INF("Sleeping for %d ms", sleep_time_ms);
		k_sleep(K_MSEC(sleep_time_ms));
	}
}

/**
 * @brief Reset event callback
 *
 * @param [in] reset_count reset counter from the modem
 */
static void on_modem_reset(uint16_t reset_count)
{
	/* configure lorawan parameters after reset and start join sequence */
	smtc_app_configure_lorawan_params(STACK_ID, &lorawan_cfg);
	smtc_modem_join_network(STACK_ID);
}

/**
 * @brief Network Joined event callback
 */
static void on_modem_network_joined(void)
{
	/* Successfully joined, configure start file upload
	 */

	LOG_INF("Launching a file upload session.");
	smtc_modem_return_code_t ret = smtc_modem_file_upload_init(
		STACK_ID, 0, APP_SMTC_MODEM_LFU_CIPHER_MODE, text, APP_SMTC_MODEM_LFU_SIZE,
		APP_SMTC_MODEM_LFU_AVERAGE_DELAY);

	if (ret != SMTC_MODEM_RC_OK) {
		LOG_ERR("Unable to initialize file upload, err: %d", ret);
		/* NOTE: if ret == SMTC_MODEM_RC_FAIL, you might have forgotten to set
		 * CONFIG_LORA_BASICS_MODEM_FILE_UPLOAD
		 */
	}

	smtc_modem_file_upload_start(STACK_ID);
}

void on_modem_upload_done(smtc_modem_event_uploaddone_status_t status)
{
	LOG_INF("Upload done. Status: %s", smtc_modem_event_uploaddone_status_to_str(status));
}
```

## src/file.h
```c
/**
 * @file      file.h
 *
 * @brief     The file
 *
 * @copyright
 * The Clear BSD License
 * Copyright Semtech Corporation 2021. All rights reserved.
 *
 * Redistribution and use in source and binary forms, with or without
 * modification, are permitted (subject to the limitations in the disclaimer
 * below) provided that the following conditions are met:
 *     * Redistributions of source code must retain the above copyright
 *       notice, this list of conditions and the following disclaimer.
 *     * Redistributions in binary form must reproduce the above copyright
 *       notice, this list of conditions and the following disclaimer in the
 *       documentation and/or other materials provided with the distribution.
 *     * Neither the name of the Semtech corporation nor the
 *       names of its contributors may be used to endorse or promote products
 *       derived from this software without specific prior written permission.
 *
 * NO EXPRESS OR IMPLIED LICENSES TO ANY PARTY'S PATENT RIGHTS ARE GRANTED BY
 * THIS LICENSE. THIS SOFTWARE IS PROVIDED BY THE COPYRIGHT HOLDERS AND
 * CONTRIBUTORS "AS IS" AND ANY EXPRESS OR IMPLIED WARRANTIES, INCLUDING, BUT
 * NOT LIMITED TO, THE IMPLIED WARRANTIES OF MERCHANTABILITY AND FITNESS FOR A
 * PARTICULAR PURPOSE ARE DISCLAIMED. IN NO EVENT SHALL SEMTECH CORPORATION BE
 * LIABLE FOR ANY DIRECT, INDIRECT, INCIDENTAL, SPECIAL, EXEMPLARY, OR
 * CONSEQUENTIAL DAMAGES (INCLUDING, BUT NOT LIMITED TO, PROCUREMENT OF
 * SUBSTITUTE GOODS OR SERVICES; LOSS OF USE, DATA, OR PROFITS; OR BUSINESS
 * INTERRUPTION) HOWEVER CAUSED AND ON ANY THEORY OF LIABILITY, WHETHER IN
 * CONTRACT, STRICT LIABILITY, OR TORT (INCLUDING NEGLIGENCE OR OTHERWISE)
 * ARISING IN ANY WAY OUT OF THE USE OF THIS SOFTWARE, EVEN IF ADVISED OF THE
 * POSSIBILITY OF SUCH DAMAGE.
 */

#ifndef LFU_FILE_H
#define LFU_FILE_H

#include <stdint.h>

/**
 * @brief Text to be sent with the Large File Upload service
 *
 * @remark The text is extracted from https://www.lipsum.com/
 */
const uint8_t text[] = {
	0x4C, 0x6F, 0x72, 0x65, 0x6D, 0x20, 0x69, 0x70, 0x73, 0x75, 0x6D, 0x20, 0x64, 0x6F, 0x6C,
	0x6F, 0x72, 0x20, 0x73, 0x69, 0x74, 0x20, 0x61, 0x6D, 0x65, 0x74, 0x2C, 0x20, 0x63, 0x6F,
	0x6E, 0x73, 0x65, 0x63, 0x74, 0x65, 0x74, 0x75, 0x72, 0x20, 0x61, 0x64, 0x69, 0x70, 0x69,
	0x73, 0x63, 0x69, 0x6E, 0x67, 0x20, 0x65, 0x6C, 0x69, 0x74, 0x2E, 0x20, 0x53, 0x65, 0x64,
	0x20, 0x6E, 0x6F, 0x6E, 0x20, 0x72, 0x69, 0x73, 0x75, 0x73, 0x2E, 0x20, 0x53, 0x75, 0x73,
	0x70, 0x65, 0x6E, 0x64, 0x69, 0x73, 0x73, 0x65, 0x20, 0x6C, 0x65, 0x63, 0x74, 0x75, 0x73,
	0x20, 0x74, 0x6F, 0x72, 0x74, 0x6F, 0x72, 0x2C, 0x20, 0x64, 0x69, 0x67, 0x6E, 0x69, 0x73,
	0x73, 0x69, 0x6D, 0x20, 0x73, 0x69, 0x74, 0x20, 0x61, 0x6D, 0x65, 0x74, 0x2C, 0x20, 0x61,
	0x64, 0x69, 0x70, 0x69, 0x73, 0x63, 0x69, 0x6E, 0x67, 0x20, 0x6E, 0x65, 0x63, 0x2C, 0x20,
	0x75, 0x6C, 0x74, 0x72, 0x69, 0x63, 0x69, 0x65, 0x73, 0x20, 0x73, 0x65, 0x64, 0x2C, 0x20,
	0x64, 0x6F, 0x6C, 0x6F, 0x72, 0x2E, 0x20, 0x43, 0x72, 0x61, 0x73, 0x20, 0x65, 0x6C, 0x65,
	0x6D, 0x65, 0x6E, 0x74, 0x75, 0x6D, 0x20, 0x75, 0x6C, 0x74, 0x72, 0x69, 0x63, 0x65, 0x73,
	0x20, 0x64, 0x69, 0x61, 0x6D, 0x2E, 0x20, 0x4D, 0x61, 0x65, 0x63, 0x65, 0x6E, 0x61, 0x73,
	0x20, 0x6C, 0x69, 0x67, 0x75, 0x6C, 0x61, 0x20, 0x6D, 0x61, 0x73, 0x73, 0x61, 0x2C, 0x20,
	0x76, 0x61, 0x72, 0x69, 0x75, 0x73, 0x20, 0x61, 0x2C, 0x20, 0x73, 0x65, 0x6D, 0x70, 0x65,
	0x72, 0x20, 0x63, 0x6F, 0x6E, 0x67, 0x75, 0x65, 0x2C, 0x20, 0x65, 0x75, 0x69, 0x73, 0x6D,
	0x6F, 0x64, 0x20, 0x6E, 0x6F, 0x6E, 0x2C, 0x20, 0x6D, 0x69, 0x2E, 0x20, 0x50, 0x72, 0x6F,
	0x69, 0x6E, 0x20, 0x70, 0x6F, 0x72, 0x74, 0x74, 0x69, 0x74, 0x6F, 0x72, 0x2C, 0x20, 0x6F,
	0x72, 0x63, 0x69, 0x20, 0x6E, 0x65, 0x63, 0x20, 0x6E, 0x6F, 0x6E, 0x75, 0x6D, 0x6D, 0x79,
	0x20, 0x6D, 0x6F, 0x6C, 0x65, 0x73, 0x74, 0x69, 0x65, 0x2C, 0x20, 0x65, 0x6E, 0x69, 0x6D,
	0x20, 0x65, 0x73, 0x74, 0x20, 0x65, 0x6C, 0x65, 0x69, 0x66, 0x65, 0x6E, 0x64, 0x20, 0x6D,
	0x69, 0x2C, 0x20, 0x6E, 0x6F, 0x6E, 0x20, 0x66, 0x65, 0x72, 0x6D, 0x65, 0x6E, 0x74, 0x75,
	0x6D, 0x20, 0x64, 0x69, 0x61, 0x6D, 0x20, 0x6E, 0x69, 0x73, 0x6C, 0x20, 0x73, 0x69, 0x74,
	0x20, 0x61, 0x6D, 0x65, 0x74, 0x20, 0x65, 0x72, 0x61, 0x74, 0x2E, 0x20, 0x44, 0x75, 0x69,
	0x73, 0x20, 0x73, 0x65, 0x6D, 0x70, 0x65, 0x72, 0x2E, 0x20, 0x44, 0x75, 0x69, 0x73, 0x20,
	0x61, 0x72, 0x63, 0x75, 0x20, 0x6D, 0x61, 0x73, 0x73, 0x61, 0x2C, 0x20, 0x73, 0x63, 0x65,
	0x6C, 0x65, 0x72, 0x69, 0x73, 0x71, 0x75, 0x65, 0x20, 0x76, 0x69, 0x74, 0x61, 0x65, 0x2C,
	0x20, 0x63, 0x6F, 0x6E, 0x73, 0x65, 0x71, 0x75, 0x61, 0x74, 0x20, 0x69, 0x6E, 0x2C, 0x20,
	0x70, 0x72, 0x65, 0x74, 0x69, 0x75, 0x6D, 0x20, 0x61, 0x2C, 0x20, 0x65, 0x6E, 0x69, 0x6D,
	0x2E, 0x20, 0x50, 0x65, 0x6C, 0x6C, 0x65, 0x6E, 0x74, 0x65, 0x73, 0x71, 0x75, 0x65, 0x20,
	0x63, 0x6F, 0x6E, 0x67, 0x75, 0x65, 0x2E, 0x20, 0x55, 0x74, 0x20, 0x69, 0x6E, 0x20, 0x72,
	0x69, 0x73, 0x75, 0x73, 0x20, 0x76, 0x6F, 0x6C, 0x75, 0x74, 0x70, 0x61, 0x74, 0x20, 0x6C,
	0x69, 0x62, 0x65, 0x72, 0x6F, 0x20, 0x70, 0x68, 0x61, 0x72, 0x65, 0x74, 0x72, 0x61, 0x20,
	0x74, 0x65, 0x6D, 0x70, 0x6F, 0x72, 0x2E, 0x20, 0x43, 0x72, 0x61, 0x73, 0x20, 0x76, 0x65,
	0x73, 0x74, 0x69, 0x62, 0x75, 0x6C, 0x75, 0x6D, 0x20, 0x62, 0x69, 0x62, 0x65, 0x6E, 0x64,
	0x75, 0x6D, 0x20, 0x61, 0x75, 0x67, 0x75, 0x65, 0x2E, 0x20, 0x50, 0x72, 0x61, 0x65, 0x73,
	0x65, 0x6E, 0x74, 0x20, 0x65, 0x67, 0x65, 0x73, 0x74, 0x61, 0x73, 0x20, 0x6C, 0x65, 0x6F,
	0x20, 0x69, 0x6E, 0x20, 0x70, 0x65, 0x64, 0x65, 0x2E, 0x20, 0x50, 0x72, 0x61, 0x65, 0x73,
	0x65, 0x6E, 0x74, 0x20, 0x62, 0x6C, 0x61, 0x6E, 0x64, 0x69, 0x74, 0x20, 0x6F, 0x64, 0x69,
	0x6F, 0x20, 0x65, 0x75, 0x20, 0x65, 0x6E, 0x69, 0x6D, 0x2E, 0x20, 0x50, 0x65, 0x6C, 0x6C,
	0x65, 0x6E, 0x74, 0x65, 0x73, 0x71, 0x75, 0x65, 0x20, 0x73, 0x65, 0x64, 0x20, 0x64, 0x75,
	0x69, 0x20, 0x75, 0x74, 0x20, 0x61, 0x75, 0x67, 0x75, 0x65, 0x20, 0x62, 0x6C, 0x61, 0x6E,
	0x64, 0x69, 0x74, 0x20, 0x73, 0x6F, 0x64, 0x61, 0x6C, 0x65, 0x73, 0x2E, 0x20, 0x56, 0x65,
	0x73, 0x74, 0x69, 0x62, 0x75, 0x6C, 0x75, 0x6D, 0x20, 0x61, 0x6E, 0x74, 0x65, 0x20, 0x69,
	0x70, 0x73, 0x75, 0x6D, 0x20, 0x70, 0x72, 0x69, 0x6D, 0x69, 0x73, 0x20, 0x69, 0x6E, 0x20,
	0x66, 0x61, 0x75, 0x63, 0x69, 0x62, 0x75, 0x73, 0x20, 0x6F, 0x72, 0x63, 0x69, 0x20, 0x6C,
	0x75, 0x63, 0x74, 0x75, 0x73, 0x20, 0x65, 0x74, 0x20, 0x75, 0x6C, 0x74, 0x72, 0x69, 0x63,
	0x65, 0x73, 0x20, 0x70, 0x6F, 0x73, 0x75, 0x65, 0x72, 0x65, 0x20, 0x63, 0x75, 0x62, 0x69,
	0x6C, 0x69, 0x61, 0x20, 0x43, 0x75, 0x72, 0x61, 0x65, 0x3B, 0x20, 0x41, 0x6C, 0x69, 0x71,
	0x75, 0x61, 0x6D, 0x20, 0x6E, 0x69, 0x62, 0x68, 0x2E, 0x20, 0x4D, 0x61, 0x75, 0x72, 0x69,
	0x73, 0x20, 0x61, 0x63, 0x20, 0x6D, 0x61, 0x75, 0x72, 0x69, 0x73, 0x20, 0x73, 0x65, 0x64,
	0x20, 0x70, 0x65, 0x64, 0x65, 0x20, 0x70, 0x65, 0x6C, 0x6C, 0x65, 0x6E, 0x74, 0x65, 0x73,
	0x71, 0x75, 0x65, 0x20, 0x66, 0x65, 0x72, 0x6D, 0x65, 0x6E, 0x74, 0x75, 0x6D, 0x2E, 0x20,
	0x4D, 0x61, 0x65, 0x63, 0x65, 0x6E, 0x61, 0x73, 0x20, 0x61, 0x64, 0x69, 0x70, 0x69, 0x73,
	0x63, 0x69, 0x6E, 0x67, 0x20, 0x61, 0x6E, 0x74, 0x65, 0x20, 0x6E, 0x6F, 0x6E, 0x20, 0x64,
	0x69, 0x61, 0x6D, 0x20, 0x73, 0x6F, 0x64, 0x61, 0x6C, 0x65, 0x73, 0x20, 0x68, 0x65, 0x6E,
	0x64, 0x72, 0x65, 0x72, 0x69, 0x74, 0x2E, 0x20, 0x55, 0x74, 0x20, 0x76, 0x65, 0x6C, 0x69,
	0x74, 0x20, 0x6D, 0x61, 0x75, 0x72, 0x69, 0x73, 0x2C, 0x20, 0x65, 0x67, 0x65, 0x73, 0x74,
	0x61, 0x73, 0x20, 0x73, 0x65, 0x64, 0x2C, 0x20, 0x67, 0x72, 0x61, 0x76, 0x69, 0x64, 0x61,
	0x20, 0x6E, 0x65, 0x63, 0x2C, 0x20, 0x6F, 0x72, 0x6E, 0x61, 0x72, 0x65, 0x20, 0x75, 0x74,
	0x2C, 0x20, 0x6D, 0x69, 0x2E, 0x20, 0x41, 0x65, 0x6E, 0x65, 0x61, 0x6E, 0x20, 0x75, 0x74,
	0x20, 0x6F, 0x72, 0x63, 0x69, 0x20, 0x76, 0x65, 0x6C, 0x20, 0x6D, 0x61, 0x73, 0x73, 0x61,
	0x20, 0x73, 0x75, 0x73, 0x63, 0x69, 0x70, 0x69, 0x74, 0x20, 0x70, 0x75, 0x6C, 0x76, 0x69,
	0x6E, 0x61, 0x72, 0x2E, 0x20, 0x4E, 0x75, 0x6C, 0x6C, 0x61, 0x20, 0x73, 0x6F, 0x6C, 0x6C,
	0x69, 0x63, 0x69, 0x74, 0x75, 0x64, 0x69, 0x6E, 0x2E, 0x20, 0x46, 0x75, 0x73, 0x63, 0x65,
	0x20, 0x76, 0x61, 0x72, 0x69, 0x75, 0x73, 0x2C, 0x20, 0x6C, 0x69, 0x67, 0x75, 0x6C, 0x61,
	0x20, 0x6E, 0x6F, 0x6E, 0x20, 0x74, 0x65, 0x6D, 0x70, 0x75, 0x73, 0x20, 0x61, 0x6C, 0x69,
	0x71, 0x75, 0x61, 0x6D, 0x2C, 0x20, 0x6E, 0x75, 0x6E, 0x63, 0x20, 0x74, 0x75, 0x72, 0x70,
	0x69, 0x73, 0x20, 0x75, 0x6C, 0x6C, 0x61, 0x6D, 0x63, 0x6F, 0x72, 0x70, 0x65, 0x72, 0x20,
	0x6E, 0x69, 0x62, 0x68, 0x2C, 0x20, 0x69, 0x6E, 0x20, 0x74, 0x65, 0x6D, 0x70, 0x75, 0x73,
	0x20, 0x73, 0x61, 0x70, 0x69, 0x65, 0x6E, 0x20, 0x65, 0x72, 0x6F, 0x73, 0x20, 0x76, 0x69,
	0x74, 0x61, 0x65, 0x20, 0x6C, 0x69, 0x67, 0x75, 0x6C, 0x61, 0x2E, 0x20, 0x50, 0x65, 0x6C,
	0x6C, 0x65, 0x6E, 0x74, 0x65, 0x73, 0x71, 0x75, 0x65, 0x20, 0x72, 0x68, 0x6F, 0x6E, 0x63,
	0x75, 0x73, 0x20, 0x6E, 0x75, 0x6E, 0x63, 0x20, 0x65, 0x74, 0x20, 0x61, 0x75, 0x67, 0x75,
	0x65, 0x2E, 0x20, 0x49, 0x6E, 0x74, 0x65, 0x67, 0x65, 0x72, 0x20, 0x69, 0x64, 0x20, 0x66,
	0x65, 0x6C, 0x69, 0x73, 0x2E, 0x20, 0x43, 0x75, 0x72, 0x61, 0x62, 0x69, 0x74, 0x75, 0x72,
	0x20, 0x61, 0x6C, 0x69, 0x71, 0x75, 0x65, 0x74, 0x20, 0x70, 0x65, 0x6C, 0x6C, 0x65, 0x6E,
	0x74, 0x65, 0x73, 0x71, 0x75, 0x65, 0x20, 0x64, 0x69, 0x61, 0x6D, 0x2E, 0x20, 0x49, 0x6E,
	0x74, 0x65, 0x67, 0x65, 0x72, 0x20, 0x71, 0x75, 0x69, 0x73, 0x20, 0x6D, 0x65, 0x74, 0x75,
	0x73, 0x20, 0x76, 0x69, 0x74, 0x61, 0x65, 0x20, 0x65, 0x6C, 0x69, 0x74, 0x20, 0x6C, 0x6F,
	0x62, 0x6F, 0x72, 0x74, 0x69, 0x73, 0x20, 0x65, 0x67, 0x65, 0x73, 0x74, 0x61, 0x73, 0x2E,
	0x20, 0x4C, 0x6F, 0x72, 0x65, 0x6D, 0x20, 0x69, 0x70, 0x73, 0x75, 0x6D, 0x20, 0x64, 0x6F,
	0x6C, 0x6F, 0x72, 0x20, 0x73, 0x69, 0x74, 0x20, 0x61, 0x6D, 0x65, 0x74, 0x2C, 0x20, 0x63,
	0x6F, 0x6E, 0x73, 0x65, 0x63, 0x74, 0x65, 0x74, 0x75, 0x65, 0x72, 0x20, 0x61, 0x64, 0x69,
	0x70, 0x69, 0x73, 0x63, 0x69, 0x6E, 0x67, 0x20, 0x65, 0x6C, 0x69, 0x74, 0x2E, 0x20, 0x4D,
	0x6F, 0x72, 0x62, 0x69, 0x20, 0x76, 0x65, 0x6C, 0x20, 0x65, 0x72, 0x61, 0x74, 0x20, 0x6E,
	0x6F, 0x6E, 0x20, 0x6D, 0x61, 0x75, 0x72, 0x69, 0x73, 0x20, 0x63, 0x6F, 0x6E, 0x76, 0x61,
	0x6C, 0x6C, 0x69, 0x73, 0x20, 0x76, 0x65, 0x68, 0x69, 0x63, 0x75, 0x6C, 0x61, 0x2E, 0x20,
	0x4E, 0x75, 0x6C, 0x6C, 0x61, 0x20, 0x65, 0x74, 0x20, 0x73, 0x61, 0x70, 0x69, 0x65, 0x6E,
	0x2E, 0x20, 0x49, 0x6E, 0x74, 0x65, 0x67, 0x65, 0x72, 0x20, 0x74, 0x6F, 0x72, 0x74, 0x6F,
	0x72, 0x20, 0x74, 0x65, 0x6C, 0x6C, 0x75, 0x73, 0x2C, 0x20, 0x61, 0x6C, 0x69, 0x71, 0x75,
	0x61, 0x6D, 0x20, 0x66, 0x61, 0x75, 0x63, 0x69, 0x62, 0x75, 0x73, 0x2C, 0x20, 0x63, 0x6F,
	0x6E, 0x76, 0x61, 0x6C, 0x6C, 0x69, 0x73, 0x20, 0x69, 0x64, 0x2C, 0x20, 0x63, 0x6F, 0x6E,
	0x67, 0x75, 0x65, 0x20, 0x65, 0x75, 0x2C, 0x20, 0x71, 0x75, 0x61, 0x6D, 0x2E, 0x20, 0x4D,
	0x61, 0x75, 0x72, 0x69, 0x73, 0x20, 0x75, 0x6C, 0x6C, 0x61, 0x6D, 0x63, 0x6F, 0x72, 0x70,
	0x65, 0x72, 0x20, 0x66, 0x65, 0x6C, 0x69, 0x73, 0x20, 0x76, 0x69, 0x74, 0x61, 0x65, 0x20,
	0x65, 0x72, 0x61, 0x74, 0x2E, 0x20, 0x50, 0x72, 0x6F, 0x69, 0x6E, 0x20, 0x66, 0x65, 0x75,
	0x67, 0x69, 0x61, 0x74, 0x2C, 0x20, 0x61, 0x75, 0x67, 0x75, 0x65, 0x20, 0x6E, 0x6F, 0x6E,
	0x20, 0x65, 0x6C, 0x65, 0x6D, 0x65, 0x6E, 0x74, 0x75, 0x6D, 0x20, 0x70, 0x6F, 0x73, 0x75,
	0x65, 0x72, 0x65, 0x2C, 0x20, 0x6D, 0x65, 0x74, 0x75, 0x73, 0x20, 0x70, 0x75, 0x72, 0x75,
	0x73, 0x20, 0x69, 0x61, 0x63, 0x75, 0x6C, 0x69, 0x73, 0x20, 0x6C, 0x65, 0x63, 0x74, 0x75,
	0x73, 0x2C, 0x20, 0x65, 0x74, 0x20, 0x74, 0x72, 0x69, 0x73, 0x74, 0x69, 0x71, 0x75, 0x65,
	0x20, 0x6C, 0x69, 0x67, 0x75, 0x6C, 0x61, 0x20, 0x6A, 0x75, 0x73, 0x74, 0x6F, 0x20, 0x76,
	0x69, 0x74, 0x61, 0x65, 0x20, 0x6D, 0x61, 0x67, 0x6E, 0x61, 0x2E, 0x20, 0x41, 0x6C, 0x69,
	0x71, 0x75, 0x61, 0x6D, 0x20, 0x63, 0x6F, 0x6E, 0x76, 0x61, 0x6C, 0x6C, 0x69, 0x73, 0x20,
	0x73, 0x6F, 0x6C, 0x6C, 0x69, 0x63, 0x69, 0x74, 0x75, 0x64, 0x69, 0x6E, 0x20, 0x70, 0x75,
	0x72, 0x75, 0x73, 0x2E, 0x20, 0x50, 0x72, 0x61, 0x65, 0x73, 0x65, 0x6E, 0x74, 0x20, 0x61,
	0x6C, 0x69, 0x71, 0x75, 0x61, 0x6D, 0x2C, 0x20, 0x65, 0x6E, 0x69, 0x6D, 0x20, 0x61, 0x74,
	0x20, 0x66, 0x65, 0x72, 0x6D, 0x65, 0x6E, 0x74, 0x75, 0x6D, 0x20, 0x6D, 0x6F, 0x6C, 0x6C,
	0x69, 0x73, 0x2C, 0x20, 0x6C, 0x69, 0x67, 0x75, 0x6C, 0x61, 0x20, 0x6D, 0x61, 0x73, 0x73,
	0x61, 0x20, 0x61, 0x64, 0x69, 0x70, 0x69, 0x73, 0x63, 0x69, 0x6E, 0x67, 0x20, 0x6E, 0x69,
	0x73, 0x6C, 0x2C, 0x20, 0x61, 0x63, 0x20, 0x65, 0x75, 0x69, 0x73, 0x6D, 0x6F, 0x64, 0x20,
	0x6E, 0x69, 0x62, 0x68, 0x20, 0x6E, 0x69, 0x73, 0x6C, 0x20, 0x65, 0x75, 0x20, 0x6C, 0x65,
	0x63, 0x74, 0x75, 0x73, 0x2E, 0x20, 0x46, 0x75, 0x73, 0x63, 0x65, 0x20, 0x76, 0x75, 0x6C,
	0x70, 0x75, 0x74, 0x61, 0x74, 0x65, 0x20, 0x73, 0x65, 0x6D, 0x20, 0x61, 0x74, 0x20, 0x73,
	0x61, 0x70, 0x69, 0x65, 0x6E, 0x2E, 0x20, 0x56, 0x69, 0x76, 0x61, 0x6D, 0x75, 0x73, 0x20,
	0x6C, 0x65, 0x6F, 0x2E, 0x20, 0x41, 0x6C, 0x69, 0x71, 0x75, 0x61, 0x6D, 0x20, 0x65, 0x75,
	0x69, 0x73, 0x6D, 0x6F, 0x64, 0x20, 0x6C, 0x69, 0x62, 0x65, 0x72, 0x6F, 0x20, 0x65, 0x75,
	0x20, 0x65, 0x6E, 0x69, 0x6D, 0x2E, 0x20, 0x4E, 0x75, 0x6C, 0x6C, 0x61, 0x20, 0x6E, 0x65,
	0x63, 0x20, 0x66, 0x65, 0x6C, 0x69, 0x73, 0x20, 0x73, 0x65, 0x64, 0x20, 0x6C, 0x65, 0x6F,
	0x20, 0x70, 0x6C, 0x61, 0x63, 0x65, 0x72, 0x61, 0x74, 0x20, 0x69, 0x6D, 0x70, 0x65, 0x72,
	0x64, 0x69, 0x65, 0x74, 0x2E, 0x20, 0x41, 0x65, 0x6E, 0x65, 0x61, 0x6E, 0x20, 0x73, 0x75,
	0x73, 0x63, 0x69, 0x70, 0x69, 0x74, 0x20, 0x6E, 0x75, 0x6C, 0x6C, 0x61, 0x20, 0x69, 0x6E,
	0x20, 0x6A, 0x75, 0x73, 0x74, 0x6F, 0x2E, 0x20, 0x53, 0x75, 0x73, 0x70, 0x65, 0x6E, 0x64,
	0x69, 0x73, 0x73, 0x65, 0x20, 0x63, 0x75, 0x72, 0x73, 0x75, 0x73, 0x20, 0x72, 0x75, 0x74,
	0x72, 0x75, 0x6D, 0x20, 0x61, 0x75, 0x67, 0x75, 0x65, 0x2E, 0x20, 0x4E, 0x75, 0x6C, 0x6C,
	0x61, 0x20, 0x74, 0x69, 0x6E, 0x63, 0x69, 0x64, 0x75, 0x6E, 0x74, 0x20, 0x74, 0x69, 0x6E,
	0x63, 0x69, 0x64, 0x75, 0x6E, 0x74, 0x20, 0x6D, 0x69, 0x2E, 0x20, 0x43, 0x75, 0x72, 0x61,
	0x62, 0x69, 0x74, 0x75, 0x72, 0x20, 0x69, 0x61, 0x63, 0x75, 0x6C, 0x69, 0x73, 0x2C, 0x20,
	0x6C, 0x6F, 0x72, 0x65, 0x6D, 0x20, 0x76, 0x65, 0x6C, 0x20, 0x72, 0x68, 0x6F, 0x6E, 0x63,
	0x75, 0x73, 0x20, 0x66, 0x61, 0x75, 0x63, 0x69, 0x62, 0x75, 0x73, 0x2C, 0x20, 0x66, 0x65,
	0x6C, 0x69, 0x73, 0x20, 0x6D, 0x61, 0x67, 0x6E, 0x61, 0x20, 0x66, 0x65, 0x72, 0x6D, 0x65,
	0x6E, 0x74, 0x75, 0x6D, 0x20, 0x61, 0x75, 0x67, 0x75, 0x65, 0x2C, 0x20, 0x65, 0x74, 0x20,
	0x75, 0x6C, 0x74, 0x72, 0x69, 0x63, 0x69, 0x65, 0x73, 0x20, 0x6C, 0x61, 0x63, 0x75, 0x73,
	0x20, 0x6C, 0x6F, 0x72, 0x65, 0x6D, 0x20, 0x76, 0x61, 0x72, 0x69, 0x75, 0x73, 0x20, 0x70,
	0x75, 0x72, 0x75, 0x73, 0x2E, 0x20, 0x43, 0x75, 0x72, 0x61, 0x62, 0x69, 0x74, 0x75, 0x72,
	0x20, 0x65, 0x75, 0x20, 0x61, 0x6D, 0x65, 0x74};

#endif // LFU_FILE_H
```
