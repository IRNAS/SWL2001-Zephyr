## samples/almanac_update/sample.yaml
```yaml
sample:
  description: Demonstrates incremental LoRa Edge almanac updates over LoRaWAN
  name: LoRaWAN almanac update
common:
  tags:
    - release
  platform_allow:
    - nrf52840dk_nrf52840
tests:
  sample.almanac_update: {}
```

## samples/dm_info/sample.yaml
```yaml
sample:
  description: Demonstrates LoRa Cloud Device Management information messages
  name: LoRaWAN DM info
common:
  tags:
    - release
  platform_allow:
    - nrf52840dk_nrf52840
tests:
  sample.dm_info: {}
```

## samples/lorawan_asynchronous_fhss/sample.yaml
```yaml
sample:
  description: Demonstrates button-triggered asynchronous LR-FHSS uplinks over LoRaWAN
  name: LoRaWAN asynchronous LR-FHSS uplink
common:
  tags:
    - release
  platform_allow:
    - nrf52840dk_nrf52840
tests:
  sample.lorawan_asynchronous_fhss: {}
```
